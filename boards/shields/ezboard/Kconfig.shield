## boards/shields/ezboard/Kconfig.shield
```kconfig
config SHIELD_EZBOARD_LEFT
    def_bool $(shields_list_contains,ezboard_left)

config SHIELD_EZBOARD_RIGHT
    def_bool $(shields_list_contains,ezboard_right)
```
